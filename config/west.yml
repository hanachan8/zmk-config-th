## config/west.yml
```yaml
manifest:
  remotes:
    - name: zmkfirmware
      url-base: https://github.com/zmkfirmware
    - name: badjeff
      url-base: https://github.com/badjeff
    - name: caksoylar
      url-base: https://github.com/caksoylar
  projects:
    - name: zmk
      remote: zmkfirmware
      revision: v0.2.1
      import: app/west.yml
    - name: zmk-pmw3610-driver
      remote: badjeff
      revision: 14d39b7a6944d1014544a2382707b14724c22f49
    - name: zmk-rgbled-widget
      remote: caksoylar
      revision: 6d8e399cb8ec794f9ade7def4223ceed764c0f14
  self:
    path: config
```
